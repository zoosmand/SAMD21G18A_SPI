__FontMap_5x7

char_00     DCD 0, 0
char_01     DCD 0, 0
char_02     DCD 0, 0
char_03     DCD 0, 0
char_04     DCD 0, 0
char_05     DCD 0, 0
char_06     DCD 0, 0
char_07     DCD 0, 0
char_08     DCD 0, 0
char_09     DCD 0, 0
char_0a     DCD 0, 0
char_0b     DCD 0, 0
char_0c     DCD 0, 0
char_0d     DCD 0, 0
char_0e     DCD 0, 0
char_0f     DCD 0, 0
char_10     DCD 0, 0
char_11     DCD 0, 0
char_12     DCD 0, 0
char_13     DCD 0, 0
char_14     DCD 0, 0
char_15     DCD 0, 0
char_16     DCD 0, 0
char_17     DCD 0, 0
char_18     DCD 0, 0
char_19     DCD 0, 0
char_1a     DCD 0, 0
char_1b     DCD 0, 0
char_1c     DCD 0, 0
char_1d     DCD 0, 0
char_1e     DCD 0, 0
char_1f     DCD 0, 0
char_20     DCD 0x00000000, 0x00000000
char_21     DCD 0, 0
char_22     DCD 0, 0
char_23     DCD 0, 0
char_24     DCD 0, 0
char_25     DCD 0, 0
char_26     DCD 0, 0
char_27     DCD 0, 0
char_28     DCD 0, 0
char_29     DCD 0, 0
char_2a     DCD 0, 0
char_2b     DCD 0, 0
char_2c     DCD 0, 0
char_2d     DCD 0, 0
char_2e     DCD 0x00008000, 0x00000000
char_2f     DCD 0, 0
char_30     DCD 0xc8887000, 0x708898a8
char_31     DCD 0x4040e000, 0x40c04040
char_32     DCD 0x2040f800, 0x70880810
char_33     DCD 0x08087000, 0x78102010
char_34     DCD 0xf8101000, 0x10305090
char_35     DCD 0x08087000, 0xf880f008
char_36     DCD 0x88887000, 0x304080f0
char_37     DCD 0x20202000, 0xf8880810
char_38     DCD 0x88887000, 0x70888870
char_39     DCD 0x08106000, 0x70888878
char_3a     DCD 0, 0
char_3b     DCD 0, 0
char_3c     DCD 0, 0
char_3d     DCD 0, 0
char_3e     DCD 0, 0
char_3f     DCD 0, 0
char_40     DCD 0, 0
char_41     DCD 0, 0
char_42     DCD 0, 0
char_43     DCD 0, 0
char_44     DCD 0, 0
char_45     DCD 0, 0
char_46     DCD 0, 0
char_47     DCD 0, 0
char_48     DCD 0, 0
char_49     DCD 0, 0
char_4a     DCD 0, 0
char_4b     DCD 0, 0
char_4c     DCD 0, 0
char_4d     DCD 0, 0
char_4e     DCD 0, 0
char_4f     DCD 0, 0
char_50     DCD 0, 0
char_51     DCD 0, 0
char_52     DCD 0, 0
char_53     DCD 0, 0
char_54     DCD 0, 0
char_55     DCD 0, 0
char_56     DCD 0, 0
char_57     DCD 0, 0
char_58     DCD 0, 0
char_59     DCD 0, 0
char_5a     DCD 0, 0
char_5b     DCD 0, 0
char_5c     DCD 0, 0
char_5d     DCD 0, 0
char_5e     DCD 0, 0
char_5f     DCD 0, 0
char_60     DCD 0, 0
char_61     DCD 0, 0
char_62     DCD 0, 0
char_63     DCD 0, 0
char_64     DCD 0, 0
char_65     DCD 0, 0
char_66     DCD 0, 0
char_67     DCD 0, 0
char_68     DCD 0, 0
char_69     DCD 0, 0
char_6a     DCD 0, 0
char_6b     DCD 0, 0
char_6c     DCD 0, 0
char_6d     DCD 0, 0
char_6e     DCD 0, 0
char_6f     DCD 0, 0
char_70     DCD 0, 0
char_71     DCD 0, 0
char_72     DCD 0, 0
char_73     DCD 0, 0
char_74     DCD 0, 0
char_75     DCD 0, 0
char_76     DCD 0, 0
char_77     DCD 0, 0
char_78     DCD 0, 0
char_79     DCD 0, 0
char_7a     DCD 0, 0
char_7b     DCD 0, 0
char_7c     DCD 0, 0
char_7d     DCD 0, 0
char_7e     DCD 0, 0
char_7f     DCD 0, 0

fontMap_5x7 DCD \
    char_00, char_01, char_02, char_03, char_04, char_05, char_06, char_07, \
    char_08, char_09, char_0a, char_0b, char_0c, char_0d, char_0e, char_0f, \
    char_10, char_11, char_12, char_13, char_14, char_15, char_16, char_17, \
    char_18, char_19, char_1a, char_1b, char_1c, char_1d, char_1e, char_1f, \
    char_20, char_21, char_22, char_23, char_24, char_25, char_26, char_27, \
    char_28, char_29, char_2a, char_2b, char_2c, char_2d, char_2e, char_2f, \
    char_30, char_31, char_32, char_33, char_34, char_35, char_36, char_37, \
    char_38, char_39, char_3a, char_3b, char_3c, char_3d, char_3e, char_3f, \
    char_40, char_41, char_42, char_43, char_44, char_45, char_46, char_47, \
    char_48, char_49, char_4a, char_4b, char_4c, char_4d, char_4e, char_4f, \
    char_50, char_51, char_52, char_53, char_54, char_55, char_56, char_57, \
    char_58, char_59, char_5a, char_5b, char_5c, char_5d, char_5e, char_5f, \
    char_60, char_61, char_62, char_63, char_64, char_65, char_66, char_67, \
    char_68, char_69, char_6a, char_6b, char_6c, char_6d, char_6e, char_6f, \
    char_70, char_71, char_72, char_73, char_74, char_75, char_76, char_77, \
    char_78, char_79, char_7a, char_7b, char_7c, char_7d, char_7e, char_7f


; Compression hash

comp_00     DCB 0
comp_01     DCB 0
comp_02     DCB 0
comp_03     DCB 0
comp_04     DCB 0
comp_05     DCB 0
comp_06     DCB 0
comp_07     DCB 0
comp_08     DCB 0
comp_09     DCB 0
comp_0a     DCB 0
comp_0b     DCB 0
comp_0c     DCB 0
comp_0d     DCB 0
comp_0e     DCB 0
comp_0f     DCB 0
comp_10     DCB 0
comp_11     DCB 0
comp_12     DCB 0
comp_13     DCB 0
comp_14     DCB 0
comp_15     DCB 0
comp_16     DCB 0
comp_17     DCB 0
comp_18     DCB 0
comp_19     DCB 0
comp_1a     DCB 0
comp_1b     DCB 0
comp_1c     DCB 0
comp_1d     DCB 0
comp_1e     DCB 0
comp_1f     DCB 0
comp_20     DCB 4
comp_21     DCB 0
comp_22     DCB 0
comp_23     DCB 0
comp_24     DCB 0
comp_25     DCB 0
comp_26     DCB 0
comp_27     DCB 0
comp_28     DCB 0
comp_29     DCB 0
comp_2a     DCB 0
comp_2b     DCB 0
comp_2c     DCB 0
comp_2d     DCB 0
comp_2e     DCB 7
comp_2f     DCB 0
comp_30     DCB 2
comp_31     DCB 4
comp_32     DCB 2
comp_33     DCB 2
comp_34     DCB 2
comp_35     DCB 2
comp_36     DCB 2
comp_37     DCB 2
comp_38     DCB 2
comp_39     DCB 0
comp_3a     DCB 0
comp_3b     DCB 0
comp_3c     DCB 0
comp_3d     DCB 0
comp_3e     DCB 0
comp_3f     DCB 0
comp_40     DCB 0
comp_41     DCB 0
comp_42     DCB 0
comp_43     DCB 0
comp_44     DCB 0
comp_45     DCB 0
comp_46     DCB 0
comp_47     DCB 0
comp_48     DCB 0
comp_49     DCB 0
comp_4a     DCB 0
comp_4b     DCB 0
comp_4c     DCB 0
comp_4d     DCB 0
comp_4e     DCB 0
comp_4f     DCB 0
comp_50     DCB 0
comp_51     DCB 0
comp_52     DCB 0
comp_53     DCB 0
comp_54     DCB 0
comp_55     DCB 0
comp_56     DCB 0
comp_57     DCB 0
comp_58     DCB 0
comp_59     DCB 0
comp_5a     DCB 0
comp_5b     DCB 0
comp_5c     DCB 0
comp_5d     DCB 0
comp_5e     DCB 0
comp_5f     DCB 0
comp_60     DCB 0
comp_61     DCB 0
comp_62     DCB 0
comp_63     DCB 0
comp_64     DCB 0
comp_65     DCB 0
comp_66     DCB 0
comp_67     DCB 0
comp_68     DCB 0
comp_69     DCB 0
comp_6a     DCB 0
comp_6b     DCB 0
comp_6c     DCB 0
comp_6d     DCB 0
comp_6e     DCB 0
comp_6f     DCB 0
comp_70     DCB 0
comp_71     DCB 0
comp_72     DCB 0
comp_73     DCB 0
comp_74     DCB 0
comp_75     DCB 0
comp_76     DCB 0
comp_77     DCB 0
comp_78     DCB 0
comp_79     DCB 0
comp_7a     DCB 0
comp_7b     DCB 0
comp_7c     DCB 0
comp_7d     DCB 0
comp_7e     DCB 0
comp_7f     DCB 0


compMap_5x7 DCD \
    comp_00, comp_01, comp_02, comp_03, comp_04, comp_05, comp_06, comp_07, \
    comp_08, comp_09, comp_0a, comp_0b, comp_0c, comp_0d, comp_0e, comp_0f, \
    comp_10, comp_11, comp_12, comp_13, comp_14, comp_15, comp_16, comp_17, \
    comp_18, comp_19, comp_1a, comp_1b, comp_1c, comp_1d, comp_1e, comp_1f, \
    comp_20, comp_21, comp_22, comp_23, comp_24, comp_25, comp_26, comp_27, \
    comp_28, comp_29, comp_2a, comp_2b, comp_2c, comp_2d, comp_2e, comp_2f, \
    comp_30, comp_31, comp_32, comp_33, comp_34, comp_35, comp_36, comp_37, \
    comp_38, comp_39, comp_3a, comp_3b, comp_3c, comp_3d, comp_3e, comp_3f, \
    comp_40, comp_41, comp_42, comp_43, comp_44, comp_45, comp_46, comp_47, \
    comp_48, comp_49, comp_4a, comp_4b, comp_4c, comp_4d, comp_4e, comp_4f, \
    comp_50, comp_51, comp_52, comp_53, comp_54, comp_55, comp_56, comp_57, \
    comp_58, comp_59, comp_5a, comp_5b, comp_5c, comp_5d, comp_5e, comp_5f, \
    comp_60, comp_61, comp_62, comp_63, comp_64, comp_65, comp_66, comp_67, \
    comp_68, comp_69, comp_6a, comp_6b, comp_6c, comp_6d, comp_6e, comp_6f, \
    comp_70, comp_71, comp_72, comp_73, comp_74, comp_75, comp_76, comp_77, \
    comp_78, comp_79, comp_7a, comp_7b, comp_7c, comp_7d, comp_7e, comp_7f


    END